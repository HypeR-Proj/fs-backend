## Kconfig
```kconfig
# SPDX-FileCopyrightText: 2026 roolrz
# SPDX-License-Identifier: Apache-2.0

config SYSTEM_APP_FS_BACKEND_SYSTEM
    bool "fs-backend-system (/svc/fs-backend)"
    default y
    depends on SYSTEM_APP_COMPONENT_MANAGER
    help
        Build and deploy hyper-fs-backend-system at /svc/fs-backend.
```
